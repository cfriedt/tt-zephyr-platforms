## drivers/mfd/Kconfig
```kconfig
#  Copyright (c) 2025 Tenstorrent AI ULC
#  SPDX-License-Identifier: Apache-2.0

if MFD

menu "Multi-function device (MFD) drivers"

# zephyr-keep-sorted-start
rsource "Kconfig.max6639"
rsource "Kconfig.tt_bh_pvt"
# zephyr-keep-sorted-stop

endmenu

endif
```

## drivers/mfd/Kconfig.tt_bh_pvt
```kconfig
#  Copyright (c) 2025 Tenstorrent AI ULC
#  SPDX-License-Identifier: Apache-2.0

config MFD_TT_BH_PVT
    bool "Support for Tenstorrent Blackhole process, voltage, and temperature MFD devices"
    default y if DT_HAS_TENSTORRENT_BH_PVT_ENABLED
    help
      This option enables support for the Tenstorrent Blackhole PVT MFD driver.
```

## drivers/pcie/Kconfig
```kconfig
#  Copyright (c) 2025 Tenstorrent AI ULC
#  SPDX-License-Identifier: Apache-2.0

source "drivers/pcie/endpoint/Kconfig"
```

## drivers/pcie/endpoint/Kconfig
```kconfig
# Copyright 2025 Tenstorrent AI ULC
# SPDX-License-Identifier: Apache-2.0

if PCIE_ENDPOINT

menu "PCIe Endpoint Drivers"

rsource "Kconfig.dw"

endmenu

endif
```

## drivers/pcie/endpoint/Kconfig.dw
```kconfig
# Copyright 2025 Tenstorrent AI ULC
# SPDX-License-Identifier: Apache-2.0

menuconfig PCIE_EP_DW
	bool "Synopsys Designware PCIe EP driver"
	help
	  This option enables Synopsys Designware PCIe EP driver.

if PCIE_EP_DW

endif # PCIE_EP_IPROC
```

## drivers/sensor/tenstorrent/Kconfig
```kconfig
# Copyright (c) 2025 Tenstorrent AI ULC
# SPDX-License-Identifier: Apache-2.0

# zephyr-keep-sorted-start
rsource "bh_pvt_vmon/Kconfig"
rsource "bh_pvt_temp/Kconfig"
# zephyr-keep-sorted-stop
```

## drivers/sensor/tenstorrent/bh_pvt_temp/Kconfig
```kconfig
#  Copyright (c) 2025 Tenstorrent AI ULC
#  SPDX-License-Identifier: Apache-2.0

config TT_BH_PVT_TEMP
    bool "Support for Tenstorrent Blackhole PVT temperature sensors"
    default y if DT_HAS_TENSTORRENT_BH_PVT_TEMP_ENABLED
    help
      This option enables support for Tenstorrent Blackhole PVT temperature sensors.

if TT_BH_PVT_TEMP

choice
        prompt "Trigger mode"
        default TT_BH_PVT_TEMP_TRIGGER_GLOBAL_THREAD
        help
          Specify the type of triggering to be used by the driver.

config TT_BH_PVT_TEMP_TRIGGER_NONE
        bool "No trigger"

config TT_BH_PVT_TEMP_TRIGGER_GLOBAL_THREAD
        bool "Use global thread"
        select TT_BH_PVT_TEMP_TRIGGER

config TT_BH_PVT_TEMP_TRIGGER_OWN_THREAD
        bool "Use own thread"
        select TT_BH_PVT_TEMP_TRIGGER

endchoice

config TT_BH_PVT_TEMP_TRIGGER
        bool

config TT_BH_PVT_TEMP_THREAD_PRIORITY
        int "Thread priority"
        depends on TT_BH_PVT_TEMP_TRIGGER_OWN_THREAD
        default 10
        help
          Priority of thread used by the driver to handle interrupts.

config TT_BH_PVT_TEMP_THREAD_STACK_SIZE
        int "Thread stack size"
        depends on TT_BH_PVT_TEMP_TRIGGER_OWN_THREAD
        default 1024
        help
          Stack size of thread used by the driver to handle interrupts.

endif
```

## drivers/sensor/tenstorrent/bh_pvt_vmon/Kconfig
```kconfig
#  Copyright (c) 2025 Tenstorrent AI ULC
#  SPDX-License-Identifier: Apache-2.0

config TT_BH_PVT_VMON
    bool "Support for Tenstorrent Blackhole PVT voltage monitors"
    default y if DT_HAS_TENSTORRENT_BH_PVT_VMON_ENABLED
    help
      This option enables support for Tenstorrent Blackhole PVT voltage monitors.

if TT_BH_PVT_VMON

choice
        prompt "Trigger mode"
        default TT_BH_PVT_VMON_TRIGGER_GLOBAL_THREAD
        help
          Specify the type of triggering to be used by the driver.

config TT_BH_PVT_VMON_TRIGGER_NONE
        bool "No trigger"

config TT_BH_PVT_VMON_TRIGGER_GLOBAL_THREAD
        bool "Use global thread"
        select TT_BH_PVT_VMON_TRIGGER

config TT_BH_PVT_VMON_TRIGGER_OWN_THREAD
        bool "Use own thread"
        select TT_BH_PVT_VMON_TRIGGER

endchoice

config TT_BH_PVT_VMON_TRIGGER
        bool

config TT_BH_PVT_VMON_THREAD_PRIORITY
        int "Thread priority"
        depends on TT_BH_PVT_VMON_TRIGGER_OWN_THREAD
        default 10
        help
          Priority of thread used by the driver to handle interrupts.

config TT_BH_PVT_VMON_THREAD_STACK_SIZE
        int "Thread stack size"
        depends on TT_BH_PVT_VMON_TRIGGER_OWN_THREAD
        default 1024
        help
          Stack size of thread used by the driver to handle interrupts.

endif
```

## dts/bindings/mfd/tenstorrent,bh-pvt.yaml
```yaml
# Copyright (c) 2025 Tenstorrent AI ULC
# SPDX-License-Identifier: Apache-2.0

description: |
    Tenstorrent Blackhole PVT sensor

    PVT stands for process, voltage, and temperature. These bindings are used specifically to
    describe common parts of the top-level multi-function device and to provide a parent reference to
    sub-devices.

    E.g.
    bh_pvt0: bh_pvt@0x80080000 {
      compatible = "tenstorrent,bh-pvt";
      reg = <0x80080000 0x1980>;
      interrupts = <56 1>;
      interrupt-parent = <&intc>;

      ... <sub-device nodes> ...
    };

compatible: "tenstorrent,bh-pvt"

include: base.yaml

properties:
  reg:
    required: true
    description: |
      Base address and size of the PVT device.
```

## dts/bindings/pcie/endpoint/snps,dw-pcie-ep.yaml
```yaml
# Copyright 2025 Tenstorrent AI ULC
# SPDX-License-Identifier: Apache-2.0

description: |
  Synopsys DesignWare PCIe endpoint interface

  Note: please keep compatible / synchronized with corresponding Linux snps,dw-pcie* bindings.

compatible: "snps,dw-pcie-ep"

include: [base.yaml]

properties:
  reg:
    required: true
    description: |
      DBI, DBI2, ATU, DMA, PHY and other reg-spaces required for endpoint controller
      functionality.

  reg-names:
    required: true
    enum: ["dbi", "dbi2", "atu", "dma", "phy", "addr_space"]
    description: |
      Names of reg-spaces required for endpoint controller functionality.

      Names can be one of the following:
        - dbi: Basic PCIe controller configuration space accessible over the DBI interface.
        - dbi2: Shadow PCIe config-space registers which contain configuration space, header
          space, standard, and extended structures.
        - elbi: External local bus registers. Synonymous with "app" and platform-specific.
        - app: Application-specific registers. Synonymous with "elbi" and platform-specific.
        - atu: Unrolled memory space containing internal address translation unit (iATU) and
          enhanced DMA registers.
        - dma: Platform-specific eDMA registers.
        - phy: PHY / PCS configuration registers.
        - addr_space: Outbound iATU-capable memory region for generating application-specific PCIe
          traffic such as MSI or MSI-X messages.

      Mandatory names include:
        - dbi
        - addr_space

  interrupt-names:
    enum: ["vpd", "l_eq", "dma0", "dma1", "dma2", "dma3", "sft_ce", "sft_ue", "tx_inta",
      "tx_intb", "tx_intc", "tx_intd", "legacy"]
    description: |
      Interrupt names corresponding to values in the "interrupts" property.

      Names can be one of the following:
        - vpd: Controller request to read or write virtual product data capability registers.
        - l_eq: Link equalization request flag is set.
        - dma[0-3]: Enhanced DMA transmit or receive operation is complete, or an error has
          occured. More dma registers may be added in the future if needed.
        - sft_ce: Correctable error detected by the safety feature.
        - sft_ue: Uncorrectable error detected by the safety feature.
        - app: Application or platform-specific IRQ has been raised.
        - tx_int[a-d]: Triggered when the device has sent an Assert or Deassert message to the
          upstream device.
        - legacy: Combined interrupt signal raised when the IRQ has sent an Assert message.

        No interrupts are required, but if specified, they must be named and the "interrupt-names"
        property must have the same number of elements as the "interrupts" property.
  
  max-functions:
    type: int
    descriptions: |
      Maximum number of PCIe functions provided by the endpoint.
```

## dts/bindings/sensor/tenstorrent,bh-pvt-temp.yaml
```yaml
# Copyright (c) 2025 Tenstorrent AI ULC
# SPDX-License-Identifier: Apache-2.0

description: |
    Tenstorrent Blackhole PVT temperature sensor

    PVT stands for process, voltage, and temperature. These bindings are used specifically to
    describe the associated temerature sensor nodes of the multi-function PVT device.
    
    E.g.
    bh_pvt0: bh_pvt@0x80080000 {
      compatible = "tenstorrent,bh-pvt";
      reg = <0x80080000 0x1980>;
      interrupts = <56 1>;
      interrupt-parent = <&intc>;

      #size-cells = <0>;

      bh_pvt_temp0: bh_pvt_temp@0 {
        compatible = "tenstorrent,bh-pvt-temp";
        reg = <0>;
      };

      bh_pvt_temp1: bh_pvt_temp@1 {
        compatible = "tenstorrent,bh-pvt-temp";
        reg = <1>;
      };
    };

compatible: "tenstorrent,bh-pvt-temp"

include: [sensor-device.yaml]

properties:
  reg:
    required: true
    description: |
      Instance number of sensor.

  sample-period-ms:
    type: int
    default: 5
    description: |
      Temperature sample period in milliseconds.
```

## dts/bindings/sensor/tenstorrent,bh-pvt-vmon.yaml
```yaml
# Copyright (c) 2025 Tenstorrent AI ULC
# SPDX-License-Identifier: Apache-2.0

description: |
    Tenstorrent Blackhole PVT voltage monitor

    PVT stands for process, voltage, and temperature. These bindings are used specifically to
    describe the associated voltage monitor nodes of the multi-function PVT device.
    
    bh_pvt0: bh_pvt@0x80080000 {
      compatible = "tenstorrent,bh-pvt";
      reg = <0x80080000 0x1980>;
      interrupts = <56 1>;
      interrupt-parent = <&intc>;

      #size-cells = <0>;

      bh_pvt_vmon0: bh_pvt_vmon@0 {
        compatible = "tenstorrent,bh-pvt-vmon";
        reg = <0>;
      };

      bh_pvt_vmon1: bh_pvt_vmon@1 {
        compatible = "tenstorrent,bh-pvt-vmon";
        reg = <1>;
      };
    };

compatible: "tenstorrent,bh-pvt-vmon"

include: [sensor-device.yaml]

properties:
  reg:
    required: true
    description: |
      Instance number of sensor.

  sample-period-ms:
    type: int
    default: 5
    description: |
      Temperature sample period in milliseconds.
```

## lib/pyocdprog/Kconfig
```kconfig
# Copyright (c) 2025 Tenstorrent AI ULC
# SPDX-License-Identifier: Apache-2.0

config PYOCDPROG
    bool "Enable PyOCD Flash Programmer"
    depends on FLASH
    depends on CRC

if PYOCDPROG

config PYOCDPROG_BUFFER_SIZE
    int "Buffer size for pyocdprog"
    default 256

config PYOCDPROG_BUFFER_COUNT
    int "Number of buffers for pyocdprog"
    default 2

config PYOCDPROG_POLLING_INTERVAL_MS
    int "Polling interval for pyocdprog"
    default 10

module = PYOCDPROG
module-str = PyOCD Flash Programmer
source "subsys/logging/Kconfig.template.log_config"

config PYOCDPROG_MAIN
    bool "Provide a simple main applicaiton for PyOCD Flash Programmer"

if SHELL

config PYOCDPROG_SHELL
    bool "Enable PyOCD Flash Programmer shell"

endif # SHELL

endif # PYOCDPROG
```

## tests/lib/tenstorrent/tt_flash_lock/testcase.yaml
```yaml
tests:
  lib.tenstorrent.tt_flash_lock:
    platform_allow:
      - tt_blackhole@p100a/tt_blackhole/smc
```

## west.yml
```yaml
# Copyright (c) 2024 Tenstorrent AI ULC
# SPDX-License-Identifier: Apache-2.0

manifest:
  remotes:
    - name: cfriedt
      url-base: https://github.com/cfriedt
    - name: zephyrproject-rtos
      url-base: https://github.com/zephyrproject-rtos

  # zephyr-keep-sorted-start re(^\s+\- name:)
  projects:
    - name: librpmi
      remote: cfriedt
      path: modules/lib/librpmi
      revision: e94e842eadc20e0269ae02d8d069de2604cd5f41
    - name: zephyr
      remote: zephyrproject-rtos
      # a stable-ish commit before v4.3.0-rc1
      revision: 3ced42c5e5272d15fa9bba1dd57614ee0fbc5de4
      import:
        name-allowlist:
          - cmsis_6
          - hal_stm32
          - mbedtls
          - mcuboot
          - nanopb
          - segger
  # zephyr-keep-sorted-stop

  group-filter:
    - +optional
```
